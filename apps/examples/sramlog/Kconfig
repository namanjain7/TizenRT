## apps/examples/sramlog/Kconfig
```kconfig
#
# For a description of the syntax of this configuration file,
# see kconfig-language at https://www.kernel.org/doc/Documentation/kbuild/kconfig-language.txt
#

config EXAMPLES_SRAMLOG
	bool "SRAM retention log test"
	depends on SRAMLOG
	default n
	---help---
		Enable the SRAM retention log example. It drives the
		sramlog character device to dump, fill or clear a small
		on-chip SRAM window that is left uninitialized across
		a warm reset.

if EXAMPLES_SRAMLOG

config EXAMPLES_SRAMLOG_PROGNAME
	string "Program name"
	default "sramlog"
	depends on BUILD_KERNEL
	---help---
		This is the name of the program that will be use when the TASH ELF
		program is installed.

endif

config USER_ENTRYPOINT
	string
	default "sramlog_main" if ENTRY_SRAMLOG
```

## apps/examples/ssm_file_logger_sample/Kconfig
```kconfig
#
# For a description of the syntax of this configuration file,
# see kconfig-language at https://www.kernel.org/doc/Documentation/kbuild/kconfig-language.txt
#

config EXAMPLES_SSM
	bool "SSM File Logger Sample"
	default n
	---help---
		Enable the SSM File Logger sample application. This demonstrates
		storing logs to a file using pthread, semaphore, mutex, and file
		I/O APIs, mirroring the SSM_file_logger.c pattern from SSM_Release.

		Commands:
		  ssm write <code> <message>   Add a log entry and write to file
		  ssm read                      Read back stored logs
		  ssm erase                     Delete the log file

config USER_ENTRYPOINT
	string
	default "ssm_main" if ENTRY_SSM
```

## apps/examples/wdog_mmu_protect_test/Kconfig
```kconfig
#
# For a description of the syntax of this configuration file,
# see kconfig-language at https://www.kernel.org/doc/Documentation/kbuild/kconfig-language.txt
#

config EXAMPLES_WDOG_MMU_PROTECT_TEST
	bool "Watchdog MMU Protection Test"
	default n
	depends on WDOG_MMU_PROTECT && DRIVERS_OS_API_TEST
	---help---
		Enable the watchdog MMU protection test command.
		This test verifies MMU-based Read-Only protection for watchdog timer
		structures via the os_api_test driver.
		Usage: wdog_mmu_protect_test <arg>
		  0 - Verify MMU protection is active (safe)
		  1 - Attempt write to protected wdog_s (DANGEROUS - Data Abort)
		  2 - Basic watchdog functionality test
```

## os/drivers/sramlog/Kconfig
```kconfig
#
# For a description of the syntax of this configuration file,
# see kconfig-language at https://www.kernel.org/doc/Documentation/kbuild/kconfig-language.txt
#

menuconfig SRAMLOG
	bool "SRAM retention log driver"
	default n
	depends on NFILE_DESCRIPTORS != 0
	---help---
		Enable the "sramlog" character driver. It exposes a small
		window of on-chip SRAM that no boot stage initializes, so
		its contents survive a warm reset. The window can be
		filled with a pattern, cleared, or dumped through ioctl.

if SRAMLOG

config SRAMLOG_BASE
	hex "SRAM log base address"
	default 0x23020118
	---help---
		Physical base of the retention window.  The default points
		into the 512B Retention RAM of the always-on domain
		(RETENTION_RAM_BASE 0x23020000, hal_platform.h), which the
		bootloader already uses to carry data across warm reboots.
		Its layout (RRAM_TypeDef, sysreg_aon.h) is: 256B system
		reserved, bootloader fields at +0x100..+0x110, then 112B
		RRAM_USER_RSVD reserved for user code, and the PCR
		registers at +0x180 (PCR_BASE).  0x23020118 is the
		word-aligned start inside RRAM_USER_RSVD, clear of the
		bootloader fields.

config SRAMLOG_SIZE
	hex "SRAM log size in bytes"
	default 0x60
	---help---
		Size of the retention window.  It must stay inside the
		RRAM_USER_RSVD area selected by SRAMLOG_BASE and must end
		well below the PCR registers at RETENTION_RAM_BASE + 0x180.
		The default 0x60 (96B, 24 words) ends at +0x178, leaving
		margin before the PCR boundary (the SDK struct offsets and
		PCR_BASE differ by one byte, hence the margin).

config SRAMLOG_DEVPATH
	string "SRAM log device path"
	default "/dev/sramlog"

endif
```
